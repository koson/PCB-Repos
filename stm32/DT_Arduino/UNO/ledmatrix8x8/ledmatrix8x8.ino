byte row[8]={9,10,11,12,13,14,15,16};
byte column[8]={1,2,3,4,5,6,7,8};
void setup() {
  // put your setup code here, to run once:
  Serial.begin(115200);
for (int i=0;i<=7;i++)
{
  pinMode(row[i],OUTPUT);
  pinMode(column[i],OUTPUT);
  digitalWrite(row[i],LOW);
  digitalWrite(column[i],LOW);
}}

void loop() {
  // put your main code here, to run repeatedly:
  char* c;
  c=chartable('A');
  char A[8]={0x00,0x66,0xFF,0xFF,0x7E,0x3C,0x18,0x00};
led8x8(A,100);
}
/*
input: all point we need to display
*/
void led8x8(char* point,uint8_t holdtime)
{
  do {
  for (int i=0;i<=7;i++)  {
      for (int j=0;j<=7;j++)
  {
    if ((point[i]>>j)&1)
    digitalWrite(column[7-j],LOW);
    else
    digitalWrite(column[7-j],HIGH);
  }
  digitalWrite(row[i],HIGH);
  delay(2);
  digitalWrite(row[i],LOW);
  }
    holdtime--;
  } while(holdtime!=0);
} 
/*
input: character want to map
return: 8 byte array
*/
char* chartable(char x)
{
  char charsymbol[] = {'A','B','C','D','E','F','G','H','I','J','K','L','M','N','O','P','Q','R','S','T','U','V','W','X','Y','Z','0','1','2','3','4','5','6','7','8','9',' ','&'};
  int n;
  n=sizeof(charsymbol)/sizeof(charsymbol[0]);
  char characterHEX[][8] = {
{0x18,0x3C,0x66,0x66,0x7E,0x66,0x66,0x66},//A
{0x78,0x64,0x68,0x78,0x64,0x66,0x66,0x7C},//B
{0x3C,0x62,0x60,0x60,0x60,0x62,0x62,0x3C},//C
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{0x00,0x66,0xFF,0xFF,0x7E,0x3C,0x18,0x00}// hình trái tim, kí hiệu là '&'
};

  for (int i=0;i<=n;i++)
  {
if (x==charsymbol[i])
return characterHEX[i];
  }}


